## LIDAR System/p4_firmware/main/Kconfig.projbuild
```kconfig
menu "WRO - pines y hardware del P4"

    config WRO_LIDAR_UART_NUM
        int "UART del LiDAR (numero)"
        default 1
        range 0 2
        help
            UART del P4 que recibe el TX del WitMotion D6.

    config WRO_LIDAR_RX_GPIO
        int "GPIO RX del P4 (se conecta al TX del LiDAR). -1 = sin LiDAR"
        default 22
        help
            Verificado con el robot: el LiDAR llega por GPIO22. GPIO37/38 (TXD/RXD de la placa) son del enlace con el S3. Con WRO_PIN_SCAN se buscan pines con datos.

    config WRO_LIDAR_ANGLE_SIGN
        int "Sentido del angulo del LiDAR (1 o -1)"
        default 1
        help
            Positivo: el angulo crece en el sentido de giro del LiDAR. Verificar con el robot
            (un objeto a la derecha debe dar angulo positivo).

    config WRO_LIDAR_ANGLE_OFFSET_DEG
        int "Desfase del angulo del LiDAR (grados, 0 = el frente del D6 mira al frente del robot)"
        default 0

    config WRO_MOTOR_IN1_GPIO
        int "L298N IN1 (motor trasero, adelante) - PWM 1 kHz; -1 sin configurar"
        default -1

    config WRO_MOTOR_IN2_GPIO
        int "L298N IN2 (rueda izquierda, atras) - PWM 1 kHz"
        default -1

    config WRO_MOTOR_IN3_GPIO
        int "L298N IN3 (rueda derecha, adelante) - PWM 1 kHz"
        default 32

    config WRO_MOTOR_IN4_GPIO
        int "L298N IN4 (rueda derecha, atras) - PWM 1 kHz"
        default 33
        help
            Cableado real: IN4 en el GPIO33. Evitar GPIO24/25: son el USB-JTAG por defecto del P4 (puerto de flasheo y logs).

    config WRO_BATT_MV
        int "Voltaje de la bateria con carga completa (mV). 3S = 12600"
        default 12600
        help
            Bateria 3S: 11,1 V nominales, 12,6 V totalmente cargada. El limite usa un modelo
            aproximado de la caida del puente; comprobar el comportamiento bajo carga.

    config WRO_MOTOR_VMAX_MV
        int "Voltaje maximo del motor (mV)"
        default 12000

    config WRO_MOTOR_DROP_MV
        int "Caida de voltaje del L298N a plena carga (mV). Con 16 V de entrada, ~2000"
        default 2000

    config WRO_MOTOR_INVERT_LEFT
        bool "Invertir el sentido de la rueda izquierda"
        default n

    config WRO_MOTOR_INVERT_RIGHT
        bool "Invertir el sentido de la rueda derecha"
        default n

    config WRO_MOTOR_MAX_CM_S
        int "Velocidad de la rueda con el PWM en su tope de 12 V (cm/s, por medir)"
        default 40

    config WRO_USE_MIC
        bool "Controlar la traccion con MIC (Motor Intelligent Control) en lazo cerrado con el encoder"
        default n
        help
            Sin probar con el motor real. Requiere encoder A/B configurado y calibrado, y los parametros
            WRO_MIC_* medidos. Desactivado, la traccion sigue en lazo abierto (velocidad ordenada -> PWM).

    config WRO_MIC_GEAR_REDUCTION
        int "Reduccion del motorreductor (JGB37-520 de 1000 rpm: 10)"
        range 1 1000
        default 10

    config WRO_MIC_RPM_NOLOAD
        int "rpm en vacio del eje de salida del motorreductor a 12 V (JGB37-520: 1000)"
        range 1 20000
        default 1000

    config WRO_MIC_ENC_PPR
        int "Pulsos por canal y por vuelta del eje del MOTOR (Hall: 11)"
        range 1 1000
        default 11

    config WRO_MIC_MOTOR_R_MOHM
        int "Resistencia del inducido (mOhm). SUPUESTO 2600: medir con el rotor bloqueado a baja tension"
        range 100 50000
        default 2600

    config WRO_MIC_MASS_G
        int "Masa del coche montado (g). SUPUESTO 1200: pesar"
        range 100 20000
        default 1200

    config WRO_TRACK_MM
        int "Separacion entre ruedas motrices (mm)"
        default 120

    config WRO_MOTORS_ENABLED
        bool "Mover los motores (desactivado: el P4 calcula pero los motores quedan parados)"
        default n
        help
            Los motores solo se mueven despues de pulsar el boton de inicio.

    config WRO_ACKERMANN_HW_CONFIGURED
        bool "Habilitar pines del nuevo chasis Ackermann tras verificar cableado y calibracion"
        default n
        help
            Bloqueo independiente de sdkconfig antiguo. Dejar desactivado hasta verificar los
            pines, la direccion y el encoder del nuevo vehiculo.

    config WRO_ENC_LEFT_GPIO
        int "GPIO del encoder de la rueda izquierda (-1 = sin encoder)"
        default -1

    config WRO_ENC_RIGHT_GPIO
        int "GPIO del encoder de la rueda derecha (-1 = sin encoder)"
        default -1

    config WRO_AXLE_ENCODER_A_GPIO
        int "GPIO canal A del encoder del motor (-1 = sin configurar)"
        default -1

    config WRO_AXLE_ENCODER_B_GPIO
        int "GPIO canal B del encoder del motor (-1 = sin configurar)"
        default -1

    config WRO_AXLE_ENCODER_COUNTS_PER_REV
        int "Cuentas x4 por vuelta del eje de salida del motorreductor"
        range 1 1000000
        default 440
        help
            Valor inicial 11 pulsos por vuelta del motor x 4 flancos x 10 de reduccion,
            Verificar en el motor real; la transmision externa se configura por separado.

    config WRO_MOTOR_GEAR_TEETH
        int "Dientes del engranaje que gira con la salida del motorreductor"
        range 1 500
        default 1

    config WRO_DIFF_GEAR_TEETH
        int "Dientes del engranaje que acciona el diferencial"
        range 1 500
        default 1

    config WRO_AXLE_ENCODER_INVERT
        bool "Invertir signo del encoder del eje"
        default n

    config WRO_AXLE_ENCODER_CALIBRATED
        bool "Usar odometria del encoder tras confirmar escala, signo y diametro"
        default n

    config WRO_SERVO_GPIO
        int "GPIO del servo de direccion (-1 = sin configurar)"
        default -1

    config WRO_SERVO_LEFT_US
        int "Pulso en microsegundos para el limite izquierdo medido (0 = sin calibrar)"
        default 0

    config WRO_SERVO_CENTER_US
        int "Pulso en microsegundos con ruedas rectas (0 = sin calibrar)"
        default 0

    config WRO_SERVO_RIGHT_US
        int "Pulso en microsegundos para el limite derecho medido (0 = sin calibrar)"
        default 0

    config WRO_SERVO_LEFT_DEG
        int "Angulo efectivo maximo a la izquierda (grados, 0 = sin medir)"
        default 0

    config WRO_SERVO_RIGHT_DEG
        int "Angulo efectivo maximo a la derecha (grados, 0 = sin medir)"
        default 0

    config WRO_WHEEL_RADIUS_MM
        int "Radio de la rueda (mm) para convertir el encoder en grados"
        default 33
        help
            Rueda provisional de 66 mm de diametro; medir el carrito real.

    config WRO_START_GPIO
        int "GPIO del boton de arranque (-1 = sin boton; 5 = boton fisico)"
        default -1

    config WRO_IMU_SDA_GPIO
        int "MPU-6050: SDA (I2C)"
        default 53

    config WRO_IMU_SCL_GPIO
        int "MPU-6050: SCL (I2C)"
        default 48

    config WRO_IMU_INT_GPIO
        int "MPU-6050: INT (no usado por el firmware, solo referencia)"
        default 47

    config WRO_IMU_ADDR
        hex "MPU-6050: direccion I2C (0x68 con AD0 a GND, 0x69 con AD0 a 3V3)"
        default 0x68

    config WRO_IMU_SIGN
        int "MPU-6050: signo del giro (-1 si el eje Z mira hacia arriba, para dar horario positivo)"
        default -1

    config WRO_WEB_START_ENABLED
        bool "Permitir INICIAR desde la pagina web"
        default y

    config WRO_LINK_DEADMAN_S
        int "Parada automatica si, iniciado desde la pagina web, dejan de llegar latidos del S3 (segundos, 0 = desactivado)"
        default 3
        help
            No aplica cuando se inicia con el boton fisico.

    config WRO_PIN_SCAN
        bool "Diagnostico: al arrancar, buscar que GPIO recibe datos (para hallar el TX del LiDAR)"
        default n

    config WRO_CAM_BAUD
        int "Baudios del enlace con el S3 (debe coincidir con WRO_LINK_BAUD del S3)"
        default 921600

    config WRO_CAM_USB
        bool "Camara del S3 por USB (el P4 es el host CDC); si no, por UART"
        default n
        help
            Si se desactiva, el S3 se lee por UART en WRO_CAM_UART_RX_GPIO.

    config WRO_CAM_UART_RX_GPIO
        int "GPIO del P4 donde llega el TX del S3 (pin RXD de la placa)"
        default 38

    config WRO_CAM_UART_TX_GPIO
        int "GPIO del P4 que va al RX del S3 (pin TXD de la placa)"
        default 37

endmenu
```

## S3 Robot/main/Kconfig.projbuild
```kconfig
menu "WRO S3 - red y panel web"

    config WRO_WIFI_HOSTNAME
        string "Nombre de host del robot"
        default "wro-robot"

endmenu
```

## Vision System/main/Kconfig.projbuild
```kconfig
menu "WRO Vision"
config WRO_PARKING_MODE
    bool "Enable experimental magenta parking guidance"
    default n
    help
        Outputs visual guidance only; P4 must confirm stopping with sensors.
config WRO_LINK_TX_GPIO
    int "UART1 TX GPIO to ESP32-P4"
    range 0 48
    default 1
    help
        Binary detection-table link at 230400 baud, 8N1. Connect this TX
        to the P4 UART RX and share ground. Verify the selected GPIO is exposed
        and free on the exact camera-board revision before wiring.
config WRO_LINK_RX_GPIO
    int "UART1 RX GPIO from ESP32-P4 (-1 disables)"
    range -1 48
    default -1
    help
        When set, the P4 can retune the vision configuration over the same link
        (binary frames from vision_config_encode, or the text commands of
        vision_config_cmd.h). Leave at -1 if the link is one-way. The console
        UART always accepts the same commands.
config WRO_LINK_ON_CONSOLE_UART
    bool "Send the table on the console UART0 (USB-UART bridge to the P4)"
    default y
    help
        The camera board's USB-UART bridge (CH340) is wired to UART0. With this
        enabled the detection table goes out UART0 at WRO_LINK_BAUD, so one USB
        cable to the P4 carries the table (S3 to P4) and the configuration
        commands (P4 to S3). Logs are limited to errors so they cannot corrupt
        frames. The serial monitor must then use WRO_LINK_BAUD. Disable it to
        use UART1 on WRO_LINK_TX_GPIO as before.
config WRO_LINK_BAUD
    int "Baud rate of the console-UART link"
    range 115200 2000000
    default 921600
    depends on WRO_LINK_ON_CONSOLE_UART
config WRO_LOCK_AUTO_AFTER_FRAMES
    int "Default: freeze exposure/gain/white balance after N frames (0 = never)"
    range 0 100000
    default 0
    help
        0 keeps the sensor's automatic controls running, which is how the camera
        behaved before this option existed. The saved vision configuration
        (camera.lock_after_frames) overrides this value.
endmenu
```
